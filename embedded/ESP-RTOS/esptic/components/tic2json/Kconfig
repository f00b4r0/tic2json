## embedded/ESP-RTOS/esptic/components/tic2json/Kconfig
```kconfig
menu "tic2json"

    choice
    prompt "TIC version"
    default TIC2JSON_TICV02
    config TIC2JSON_TICV01
        bool "01 (Historique)"
    config TIC2JSON_TICV02
        bool "02 (Standard)"
    endchoice

endmenu
```

## embedded/ESP-RTOS/esptic/main/Kconfig
```kconfig
menu "esptic"

config ESPTIC_UART_NUM
    int "TIC UART"
    default 0
    help
        UART peripheral to use for TIC input

choice
    prompt "TIC baudrate"
    default ESPTIC_B9600
    config ESPTIC_B1200
        bool "1200 (Historique)"
    config ESPTIC_B9600
        bool "9600 (Standard)"
endchoice

config ESPTIC_BAUDRATE
    int
    default 1200 if ESPTIC_B1200
    default 9600

config ESPTIC_LED_GPIO_NUM
    int "LED GPIO NUM"
    default 2

config ESPTIC_LED_ACTIVE_HIGH
    bool "LED active high"
    help
        Set if LED is active high, unset otherwise

config ESPTIC_LED_ACTIVE_STATE
    int
    default 1 if ESPTIC_LED_ACTIVE_HIGH
    default 0

config ESPTIC_WIFI_SSID
    string "WiFi SSID"
    default "myssid"
    help
        SSID (network name) to connect to.

config ESPTIC_WIFI_PASSWORD
    string "WiFi Password"
    default "mypassword"
    help
        WiFi password (WPA2) to use.

config ESPTIC_UDP_HOST
    string "UDP remote hostname"
    default "myhost"

config ESPTIC_UDP_PORT
    string "UDP remote port"
    default "8094"

endmenu
```
